/*
 * Seeed XIAO nRF54L15 overlay.
 *
 * The board DTS already defines the mic (&pdm20 as nodelabel `dmic_dev`, with
 * pins + the `pdm_imu_pwr` regulator on P0.01, regulator-boot-on) and a single
 * gpio LED (led0). We only need to expose the mic under the `dmic-dev` alias
 * that src/mic.c looks up.
 *
 * Battery: the board has a `vbat_pwr` enable but no ready ADC channel here; add a
 * zephyr,user io-channels entry (like xiao52) once you know the sense pin.
 */

/ {
	aliases {
		dmic-dev = &pdm20;
	};
};

/* --- user button (merged from the former overlays/xiao54l.overlay) --- */
/* User button for XIAO nRF54L15. Edit the pin to your wiring.
 * nRF54L has GPIO ports P0/P1/P2. */
/ {
	buttons {
		compatible = "gpio-keys";
		user_button: user_button {
			gpios = <&gpio1 8 (GPIO_PULL_UP | GPIO_ACTIVE_LOW)>; /* TODO: your pin */
			label = "User button";
		};
	};

	aliases {
		sw0 = &user_button;
	};
};
