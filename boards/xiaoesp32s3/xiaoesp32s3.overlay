/*
 * Seeed XIAO ESP32S3 Sense — onboard PDM mic (MSM261D3526H1CPM).
 * Schematic pins (Seeed wiki):
 *     PDM CLK  -> GPIO42
 *     PDM DIN  -> GPIO41
 *
 * BLOCKER (why there is no dmic-dev node here):
 *   Zephyr v4.4.1 has NO PDM/DMIC driver for the ESP32-S3. The esp32 I2S driver
 *   (`espressif,esp32-i2s`) does not implement PDM-RX, and no `zephyr,dmic`
 *   backend exists for this SoC. A devicetree overlay can only bind pins to an
 *   existing driver, so the mic cannot be enabled here yet.
 *
 * To support the mic, a Zephyr driver is needed first, e.g.:
 *   - extend drivers/i2s/i2s_esp32.c with PDM-RX mode, then use the mpxxdtyy
 *     (PDM-over-I2S) DMIC driver on top, OR
 *   - write a DMIC driver wrapping ESP-IDF's I2S-PDM API.
 * Once such a driver + binding exist, add its node here (CLK=42, DIN=41) and the
 * `dmic-dev` alias that src/mic.c looks up.
 */

/* --- user button (merged from the former overlays/xiaoesp32s3.overlay) --- */
/* User button for XIAO ESP32S3 Sense. Edit the pin to your wiring.
 * ESP32-S3 GPIOs are on &gpio0. */
/ {
	buttons {
		compatible = "gpio-keys";
		user_button: user_button {
			gpios = <&gpio0 1 (GPIO_PULL_UP | GPIO_ACTIVE_LOW)>; /* TODO: your pin */
			label = "User button";
		};
	};

	aliases {
		sw0 = &user_button;
	};
};
