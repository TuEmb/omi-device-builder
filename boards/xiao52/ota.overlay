/*
 * OTA build — APPLICATION image: link the app into slot0. The partition table
 * itself is shared with the bootloader image; see partitions.dtsi.
 */

#include "partitions.dtsi"

/ {
	chosen {
		zephyr,code-partition = &slot0_partition;
	};
};
