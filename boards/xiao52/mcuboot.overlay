/*
 * OTA build — MCUBOOT image: link MCUboot into boot_partition. The partition
 * table itself is shared with the application image; see partitions.dtsi.
 * Passed to the mcuboot image by scripts/build_ota.* (mcuboot_EXTRA_DTC_OVERLAY_FILE).
 */

#include "partitions.dtsi"

/ {
	chosen {
		zephyr,code-partition = &boot_partition;
	};
};
