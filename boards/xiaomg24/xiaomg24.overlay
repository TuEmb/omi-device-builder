/*
 * Seeed XIAO MG24 Sense — onboard mic is the MSM381ACT001, an ANALOG MEMS mic
 * (NOT a PDM/digital mic). Schematic pins (Seeed wiki / makerguides):
 *     MIC_DATA (analog output) -> PC9   (sample via EFR32 IADC/ADC)
 *     MIC_PWR  (enable)        -> PC8
 *
 * BLOCKER (why there is no dmic-dev node here):
 *   The mic is analog, so it is not a DMIC/PDM device — the Zephyr DMIC API used
 *   by src/mic.c does not apply at all. Capturing it requires a 16 kHz
 *   ADC-sampling backend (timer-triggered IADC into a PCM buffer), plus the
 *   Silabs ADC driver. That is an application-code path to add, not an overlay.
 *
 * To support the mic:
 *   1. add a mic backend that samples PC9 via the ADC at 16 kHz (mono, 16-bit),
 *      feeding codec_receive_pcm() the same way src/mic.c does,
 *   2. drive MIC_PWR (PC8) high to power the mic,
 *   3. select that ADC backend for this board instead of the DMIC src/mic.c.
 */

/* --- user button (merged from the former overlays/xiaomg24.overlay) --- */
/* User button for XIAO MG24 Sense. Edit the pin to your wiring.
 * EFR32MG24 (Silabs) GPIO ports are &gpioa/&gpiob/&gpioc/&gpiod. */
/ {
	buttons {
		compatible = "gpio-keys";
		user_button: user_button {
			gpios = <&gpioa 0 (GPIO_PULL_UP | GPIO_ACTIVE_LOW)>; /* TODO: your pin */
			label = "User button";
		};
	};

	aliases {
		sw0 = &user_button;
	};
};
