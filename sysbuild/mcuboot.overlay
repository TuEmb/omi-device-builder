/*
 * Generic MCUboot-image tweaks (applied to every board's MCUboot build via
 * sysbuild). Board-specific flash partitions live in
 * boards/<board>/mcuboot.overlay and are passed with
 * mcuboot_EXTRA_DTC_OVERLAY_FILE (see scripts/build_ota.*).
 *
 * USB CDC ACM port for MCUboot serial recovery over Type-C.
 */
&zephyr_udc0 {
	cdc_acm_uart0: cdc_acm_uart0 {
		compatible = "zephyr,cdc-acm-uart";
	};
};
