/* User button for XIAO MG24 Sense. Edit the pin to your wiring.
 * EFR32MG24 (Silabs) GPIO ports are &gpioa/&gpiob/&gpioc/&gpiod. */
/ {
	buttons {
		compatible = "gpio-keys";
		user_button: user_button {
			gpios = <&gpioa 0 (GPIO_PULL_UP | GPIO_ACTIVE_LOW)>; /* TODO: your pin */
			label = "User button";
		};
	};

	aliases {
		sw0 = &user_button;
	};
};
