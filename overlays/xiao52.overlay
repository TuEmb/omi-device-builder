/* User button for XIAO nRF52840 Sense. Edit the pin to your wiring.
 * Example: button between D1 (P0.03) and GND, active low with pull-up. */
/ {
	buttons {
		compatible = "gpio-keys";
		user_button: user_button {
			gpios = <&gpio0 3 (GPIO_PULL_UP | GPIO_ACTIVE_LOW)>; /* TODO: your pin */
			label = "User button";
		};
	};

	aliases {
		sw0 = &user_button;
	};
};
