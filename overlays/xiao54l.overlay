/* User button for XIAO nRF54L15. Edit the pin to your wiring.
 * nRF54L has GPIO ports P0/P1/P2. */
/ {
	buttons {
		compatible = "gpio-keys";
		user_button: user_button {
			gpios = <&gpio1 8 (GPIO_PULL_UP | GPIO_ACTIVE_LOW)>; /* TODO: your pin */
			label = "User button";
		};
	};

	aliases {
		sw0 = &user_button;
	};
};
